
/* ULP variable definitions for the linker.
 * This file is generated automatically by esp32ulp_mapgen.py utility.
 */
PROVIDE ( ulp___clz_tab = 0x500007f4 );
PROVIDE ( ulp___clzsi2 = 0x5000052a );
PROVIDE ( ulp___fixunsdfsi = 0x5000047a );
PROVIDE ( ulp___floatunsidf = 0x500004de );
PROVIDE ( ulp___muldf3 = 0x50000018 );
PROVIDE ( ulp___stack_top = 0x50001000 );
PROVIDE ( ulp___start = 0x50000004 );
PROVIDE ( ulp_dataCheckedCount = 0x50000908 );
PROVIDE ( ulp_dutyCycle = 0x5000090c );
PROVIDE ( ulp_flags = 0x50000910 );
PROVIDE ( ulp_ledVal = 0x50000900 );
PROVIDE ( ulp_main = 0x50000576 );
PROVIDE ( ulp_reset_vector = 0x50000000 );
PROVIDE ( ulp_RTCCNTL = 0x50008000 );
PROVIDE ( ulp_SENS = 0x5000c800 );
PROVIDE ( ulp_ulp_riscv_halt = 0x500007ce );
PROVIDE ( ulp_ulp_riscv_rescue_from_monitor = 0x500007ae );
PROVIDE ( ulp_ulp_riscv_wakeup_main_processor = 0x500007c2 );
PROVIDE ( ulp_validatedDutyCycle = 0x50000904 );
